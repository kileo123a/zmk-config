## config/boards/shields/KLAKPad/Kconfig.shield
```kconfig
# Copyright (c) 2022 The ZMK Contributors
# SPDX-License-Identifier: MIT

config SHIELD_KLAKPAD
    def_bool $(shields_list_contains,KLAKPad)
```
